  
#include <Servo.h>
#include "AccelStepper.h"
#include <Wire.h>
//#include "DFRobot_INA219.h"
//////////////////////////////
//DFRobot_INA219_IIC     ina218(&Wire, INA219_I2C_ADDRESS1);
//DFRobot_INA219_IIC     ina219(&Wire, INA219_I2C_ADDRESS2);
//float ina218Reading_mA = 1000;
//float extMeterReading_mA = 1000;
//float ina219Reading_mA = 1000;
////float extMeterReading_mA = 1000;







////////////////////////////////////////////////////////////////////////
unsigned char head_1[5]={0x3E, 0xA6, 0x01, 0x08, 0xED};
unsigned char head_2[5]={0x3E, 0xA6, 0x02, 0x08, 0xEE};



unsigned char direc[2]={0x00,0x01};

unsigned char posi_low[1000]={0x00,\
0x0A,0x14,0x1E,0x28,0x32,0x3C,0x46,0x50,0x5A,0x64,0x6E,0x78,0x82,0x8C,0x96,0xA0,0xAA,0xB4,0xBE,0xC8,0xD2,0xDC,0xE6,0xF0,0xFA,0x04,0x0E,0x18,0x22,0x2C,\
0x36,0x40,0x4A,0x54,0x5E,0x68,0x72,0x7C,0x86,0x90,0x9A,0xA4,0xAE,0xB8,0xC2,0xCC,0xD6,0xE0,0xEA,0xF4,0xFE,0x08,0x12,0x1C,0x26,0x30,0x3A,0x44,0x4E,0x58,\
0x62,0x6C,0x76,0x80,0x8A,0x94,0x9E,0xA8,0xB2,0xBC,0xC6,0xD0,0xDA,0xE4,0xEE,0xF8,0x02,0x0C,0x16,0x20,0x2A,0x34,0x3E,0x48,0x52,0x5C,0x66,0x70,0x7A,0x84,\
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0xB6,0xC0,0xCA,0xD4,0xDE,0xE8,0xF2,0xFC,0x06};
                                 

unsigned char posi_med[1000]={0x00,\
0x00,0x00,0x00,0x00,0x00,0x00,0x00,0x00,0x00,0x00,0x00,0x00,0x00,0x00,0x00,0x00,0x00,0x00,0x00,0x00,0x00,0x00,0x00,0x00,0x00,0x01,0x01,0x01,0x01,0x01,\
0x01,0x01,0x01,0x01,0x01,0x01,0x01,0x01,0x01,0x01,0x01,0x01,0x01,0x01,0x01,0x01,0x01,0x01,0x01,0x01,0x01,0x02,0x02,0x02,0x02,0x02,0x02,0x02,0x02,0x02,\
0x02,0x02,0x02,0x02,0x02,0x02,0x02,0x02,0x02,0x02,0x02,0x02,0x02,0x02,0x02,0x02,0x03,0x03,0x03,0x03,0x03,0x03,0x03,0x03,0x03,0x03,0x03,0x03,0x03,0x03,\
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0x26,0x26,0x26,0x26,0x26,0x26,0x26,0x26,0x27};
unsigned char posi_hig[1]={0x00};
//
//unsigned char end_1[21]={0xEB,0x4F,0xB3,0x18,0x7C,0xE0,0x45,0xA9,0x0E,0x72,0xD6,0x3B,0x9F,0x04,0x68,0xCC,0x31,0x95,0xFA,0x5E,0xC2};
//unsigned char end_2[21]={0xEC,0x50,0xB4,0x19,0x7D,0xE1,0x46,0xAA,0x0F,0x73,0xD7,0x3C,0xA0,0x05,0x69,0xCD,0x32,0x96,0xFB,0x5F,0xC3};

unsigned char speed_10[4]={ 0xE8, 0x03, 0x00, 0x00};
unsigned char speed_90[4]={ 0x28, 0x33, 0x00, 0x00};
unsigned char speed_180[4]={ 0x50, 0x46, 0x00, 0x00};
unsigned char speed_360[4]={ 0xA0, 0x8C, 0x00, 0x00};

int angle_before_X = 990;
int angle_before_Y = 500;
/////////////////////////////////////////////////////////////////////////////
/////////////////////////////////////////////////////////////////////////////



String comdata = "";
String x="000";
String y="000";
String z="000";
int dir_motor=1;

boolean sig = true; 
const long range = 200LL * 150;   
const long moveSteps = -200LL;      
const int MaxSpeed = 3000;   

int val=0;                 
long aimPosition = 0LL;        
long currentPositon;



#define PWM  8     
#define DIR  9     
//#define MF  10    

#define switchEnd  A8

AccelStepper stepper1(1,PWM,DIR);
 

void setup() {
 
    pinMode(PWM,OUTPUT);
    pinMode(DIR,OUTPUT);
    pinMode(switchEnd, INPUT);
    stepper1.setMaxSpeed(5000.0);   
    stepper1.setAcceleration(3000.0);  
    Serial.begin(115200);
    Serial1.begin(115200);
    Serial2.begin(115200);
    val = analogRead(switchEnd);
    run_angle(0,1);
    delay(1000);
    run_angle(900,1);
    delay(1000);
    run_angle(0,1);
    delay(1000);
    run_angle(0,2);
    delay(1000);
    run_angle(900,2);
    delay(1000);
    run_angle(0,2);
    delay(1000);


    run_angle(675,2);
    delay(1000);
    run_angle(515,1);
    delay(1000);


  
    
    to_0_point(); 
    stepper1.run();
//    Serial2.print("k");

  
}

void loop() {
  
  String info = getinfo();
//  Serial.println("number:");
if (info.length()>0){
    x=info.substring(0,3);
    y=info.substring(3,6);
    z=info.substring(6,9);
    
  move(x.toInt(),y.toInt(),z.toInt());
  sig = true;
  stepper1.run();   
  info="";
} 
delay(100);

}



void move(int x, int y, int z){
  Serial.println("XYZ VALUE");
  Serial.println(x);
  delay(2);
  Serial.println(y);
  delay(2);
  Serial.println(z);
  delay(2);


  run_angle_stop(y,1,8);
  run_angle_stop(x,2,8);
  Serial1.println("ok");


  
    if (z == 0) 
  {
    to_0_point(); 
  }

  if (z >0 ) 
  {
  z_move(z);
  }
  
  

}

void to_0_point(){
   val = 0;
   val = analogRead(switchEnd);   
   delay(2);
   val = analogRead(switchEnd);   
   Serial.println(val);
      while(1){
//        aimPosition = aimPosition - moveSteps*2 ;
        stepper1.runToNewPosition(aimPosition );   
//           stepper1.moveTo(-2000);
        aimPosition = aimPosition - moveSteps*2 ;
        val = analogRead(switchEnd); 
        if(val <=10){
          stepper1.setCurrentPosition(100LL); 
          delay(10);
          break;
        }
      }
      Serial.println(aimPosition);
      aimPosition=0;
      sig = true;
      stepper1.run();
}

void z_move(int posi){
    if(posi>=150){
      posi=150;
    }
    if(posi>=-1){
      stepper1.runToNewPosition(moveSteps * posi); 
      delay(100);
      currentPositon = moveSteps * posi;
//      Serial.println("currentPositon ");
//      comchar = "";
    }
    stepper1.run();
}

String getinfo(){ 
  String info="";
  String comdata = ""; 
    while (Serial1.available() > 0)  
    {
        comdata += char(Serial1.read());
        delay(2);
    }
    if (comdata.length() > 0)
    { 
      Serial1.println("ok");
      if (comdata.substring(0,3)=="SSS"){
//        int T1=get_I_T(1);
        Serial1.print("ok");
        delay(2);
      }
  
      String a=comdata.substring(0,3);
      String b=comdata.substring(12,15);
      if (a=="SSS" && b=="EEE"){
          info = comdata.substring(3,12);
      }
    }
  return(info);
}


void run_angle_stop(int angle_num, int motor,int thresh){
  int steps=5;
  int angle_before;
  if (motor==1){
    angle_before=angle_before_Y;
  }
  if (motor==2){
    angle_before=angle_before_X;
  }

  if (angle_before<=angle_num){
    int n1=0;
    dir_motor=1;
    for (int i=angle_before; i<=angle_num;i+=steps){
      int T = run_angle(i,motor);
      if(T<=thresh ){
        n1+=1;
        if (n1>1)break;  
      }else{n1=0;}
    }
  }else{
    int n2=0;
    dir_motor=-1;
     for (int i=angle_before; i>=angle_num;i-=steps){
      int T = run_angle(i,motor);
      if(T<=thresh ){
        n2+=1;
        if (n2>1)break;  
      }else{n2=0;}  
    }
  }
}



int run_angle(int angle_num ,int motor){  
     int dir;


     int po_l=angle_num%256;
     int po_m=angle_num/256;
     int po_h=0;

//     String po=tohex(angle_num,6);
//     String posi_l="0x"+po.substring(0,2);
//     String posi_m="0x"+po.substring(2,4);
//     String posi_h="0x"+po.substring(4,6);

     
     if(motor==1){
        if (angle_before_Y<= angle_num){
        dir=0;    
       }else{
        dir=1;    
       }
       angle_before_Y=angle_num;
     Serial2.write(head_1,5);
     }
//
     if(motor==2){
        if (angle_before_X<= angle_num){
        dir=0;    
       }else{
        dir=1;    
       }
       angle_before_X=angle_num;
     Serial2.write(head_2,5);
     }
////   
     unsigned char end_value[1]={direc[dir]+posi_low[angle_num]+posi_med[angle_num]+posi_hig[angle_num]+speed_360[0]+speed_360[1]};  
     
     Serial2.write(direc[dir]);
     Serial2.write(posi_low[angle_num]);
     Serial2.write(posi_med[angle_num]);
     Serial2.write(posi_hig[angle_num]);
     Serial2.write(speed_360,4);
     Serial2.write(end_value[0]);
int T=get_I_T(motor);
//Serial1.println(T);
return T;
 
    }







int get_I_T(int motor){
  unsigned char get_IT_1[5]={0x3E,0x9C,0x01,0x00,0xDB};
  unsigned char get_IT_2[5]={0x3E,0x9C,0x02,0x00,0xDC};
  
  int T=0;
  int num=2;
  for(int n=0;n<num;n++){
  if (motor==1){Serial2.write(get_IT_1,5);delay(2);}
  if (motor==2){Serial2.write(get_IT_2,5);delay(2);} 
  
  String comdata="";
  while(Serial2.available()){
    comdata +=char(Serial2.read());
    delay(2);
  }
 T+=(unsigned char)comdata[6];
  }
  return abs(T/num-120);
}


    
